## drivers/switch/Kconfig
```kconfig
menuconfig SWITCH
	tristate "Switch class support"
	help
	  Say Y here to enable switch class support. This allows
	  monitoring switches by userspace via sysfs and uevent.

if SWITCH

config SWITCH_GPIO
	tristate "GPIO Swith support"
	depends on GENERIC_GPIO
	help
	  Say Y here to enable GPIO based switch support.

config SWITCH_MID
	tristate "Jack Switch support"
	depends on SWITCH
	help
	  Say Y here to support switch driver for audio jack detection.

config SWITCH_MID_USER_NOTIFY
	tristate "Userspace notification Switch support"
	help
	  Say Y here to support USER_NOTIFY switch. Needed for devices where
	  userspace requires notification of specific device events reported by drivers to
	  the USER_NOTIFY switch driver.

endif # SWITCH
```

## drivers/thermal/Kconfig
```kconfig
#
# Generic thermal sysfs drivers configuration
#

menuconfig THERMAL
	tristate "Generic Thermal sysfs driver"
	help
	  Generic Thermal Sysfs driver offers a generic mechanism for
	  thermal management. Usually it's made up of one or more thermal
	  zone and cooling device.
	  Each thermal zone contains its own temperature, trip points,
	  cooling devices.
	  All platforms with ACPI thermal support can use this driver.
	  If you want this support, you should say Y or M here.

config THERMAL_HWMON
	bool
	depends on THERMAL
	depends on HWMON=y || HWMON=THERMAL
	default y

config SPEAR_THERMAL
	bool "SPEAr thermal sensor driver"
	depends on THERMAL
	depends on PLAT_SPEAR
	help
	  Enable this to plug the SPEAr thermal sensor driver into the Linux
	  thermal framework

config DEBUG_THERMAL
	bool "Thermal debug information support"
	depends on THERMAL
	help
	  This enables debug sysfs interfaces/information for Thermal
	  subsystem.

	  Saying Y here will expose extra sysfs nodes under
	  /sys/class/thermal/thermal_zoneX/

config SENSORS_THERMAL_MRFLD
        tristate "Thermal driver for Intel Merrifield platform"
        depends on THERMAL && IIO
        help
          Say Y here to enable thermal driver on Intel Merrifield
          platform.

          To load this driver as a module, select M here. The module
          will be called "mrfl_thermal"

config INTEL_BYT_THERMAL
        tristate "Thermal driver for Intel Baytrail platform"
        depends on THERMAL && IIO
        help
          Say Y here to enable thermal driver on Intel Baytrail
          platform.

          To load this driver as a module, select M here. The module
          will be called "byt_thermal"

config SOC_THERMAL
	tristate "SoC Thermal driver"
	depends on THERMAL
	help
	  SoC Thermal driver registers to Generic Thermal Framework.
	  Exposes SoC DTS and aux trip point values through the framework.

          Say Y here to enable thermal driver on Intel Merrifield
          platform. To load this driver as a module, select M here.
```

## drivers/usb/dwc3/Kconfig
```kconfig
config USB_DWC3
	tristate "DesignWare USB3 DRD Core Support"
	depends on (USB || USB_GADGET)
	select USB_OTG_UTILS
	help
	  Say Y or M here if your system has a Dual Role SuperSpeed
	  USB controller based on the DesignWare USB3 IP Core.

	  If you choose to build this driver is a dynamically linked
	  module, the module will be called dwc3.ko.

if USB_DWC3

config USB_DWC3_DEBUG
	bool "Enable Debugging Messages"
	help
	  Say Y here to enable debugging messages on DWC3 Driver.

	  Avoid enabling these messages, even if you're actively
	  debugging such a driver.  Many drivers will emit so many
	  messages that the driver timings are affected, which will
	  either create new failure modes or remove the one you're
	  trying to track down.  Never enable these messages for a
	  production build.

config USB_DWC3_VERBOSE
	bool "Enable Verbose Debugging Messages"
	depends on USB_DWC3_DEBUG
	help
	  Say Y here to enable verbose debugging messages on DWC3 Driver.

	  Avoid enabling these messages, even if you're actively
	  debugging such a driver.  Many drivers will emit so many
	  messages that the driver timings are affected, which will
	  either create new failure modes or remove the one you're
	  trying to track down.  Never enable these messages for a
	  production build.

endif
```

## sound/soc/intel/Kconfig
```kconfig
config SND_MFLD_MACHINE
	tristate "SOC Machine Audio driver for Intel Medfield MID platform"
	depends on INTEL_SCU_IPC && INTEL_SCU_IPC_UTIL && X86 && GPIO_LANGWELL
	depends on MSIC_GPADC
	select SND_SOC_SN95031
	select SND_SST_PLATFORM
	select SND_SST_MACHINE
	select SND_INTEL_SST
	default n
	help
          This adds support for ASoC machine driver for Intel(R) MID Medfield platform
          used as alsa device in audio subsystem in Intel(R) MID devices
          Say Y if you have such a device
	  If unsure select "N".

config SND_MFLD_MACHINE_GI
	tristate "SOC Machine Audio driver for Intel Medfield GI board"
	depends on INTEL_SCU_IPC && INTEL_SCU_IPC_UTIL && X86 && GPIO_LANGWELL
	depends on MSIC_GPADC
	select SND_SOC_SN95031
	select SND_SST_PLATFORM
	select SND_SST_MACHINE
	select SND_INTEL_SST
	default n
	help
          This adds support for ASoC machine driver for Gilligan Island board, based on
	  Intel(R) MID Medfield platform. This will create an alsa sound card.
          Say Y if you have such a device
          If unsure select "N".

config SND_YUKKABEACH_MACHINE
	tristate "SOC Machine Audio driver for Intel Yukkbeach board"
	depends on INTEL_SCU_IPC && INTEL_SCU_IPC_UTIL && X86 && GPIO_LANGWELL
	depends on MSIC_GPADC
	select SND_SOC_SN95031
	select SND_SST_PLATFORM
	select SND_SST_MACHINE
	select SND_INTEL_SST
	default n
	help
          This adds support for ASoC machine driver for Yukkabeach board, based on
	  Intel(R) MID Medfield platform(and Lexington board). This will create an
	  alsa sound card.
          Say Y if you have such a device
          If unsure select "N".

config SND_MRFLD_MACHINE
	tristate "SOC Machine Audio driver for Intel Merrifield MID platform"
	depends on INTEL_SCU_IPC && X86
	select SND_SOC_LM49453
	select SND_SOC_WM8994
	select MFD_CORE
	select MFD_WM8994
	select REGULATOR_WM8994
	select SND_SST_PLATFORM
	select SND_SST_MACHINE
	select SND_INTEL_SST
	default n
	help
	  This adds support for ASoC machine driver for Intel(R) MID Merrifield platform
          used as alsa device in audio substem in Intel(R) MID devices
          Say Y if you have such a device
          If unsure select "N".

config SND_BYT_MACHINE
	tristate "SOC Machine Audio driver for Intel Baytrail MID platform"
	depends on X86
	select SND_SOC_RT5642
	select SND_SST_PLATFORM
	select SND_SST_MACHINE
	select SND_INTEL_SST
	select SND_HWDEP
	default n
	help
	  This adds support for ASoC machine driver for Intel(R) MID Baytrail platform
          used as alsa device in audio substem in Intel(R) MID devices
          Say Y if you have such a device
          If unsure select "N".

config SND_CTP_MACHINE
	tristate "SOC Machine Audio driver for Intel Cloverview MID platform"
	depends on INTEL_SCU_IPC_UTIL && X86 && GPIO_LANGWELL
	select SND_SOC_CS42L73
	select SND_SOC_WM5102
	select SND_SOC_WM8994
	select MFD_CORE
	select SND_SST_PLATFORM
	select SND_SST_MACHINE
	select SND_INTEL_SST
	select SND_COMPRESS_OFFLOAD
	select SND_SOC_COMMS_SSP
	default n
	help
          This adds support for ASoC machine driver for Intel(R) MID Cloverview platform
	  used as alsa device in audio substem in Intel(R) MID devices
          Say Y if you have such a device
          If unsure select "N".

config SND_INTEL_SST
       tristate

config SND_SST_PLATFORM
	tristate

config SND_SOC_COMMS_SSP
	tristate "Use ASOC framework to drive AudioComms SSP0 and SSP1"

config SND_MFLD_MONO_SPEAKER_SUPPORT
	tristate "Mono Speaker support for Medfield based devices"
	default N
	help
          This adds support for Mono speaker support on Intel(R) MID Medfield based devices.
          Say Y if you have device with mono speaker. If you say N support for stereo speakers
          will be enabled.
          If unsure select "N".
config PRH_TEMP_WA_FOR_SPID
	tristate "Workaround for PRh since SPID is unavailable"

config SND_SST_MACHINE
	tristate
```

## sound/soc/mid-x86/Kconfig
```kconfig
config SND_MFLD_MACHINE
	tristate "SOC Machine Audio driver for Intel Medfield MID platform"
	depends on INTEL_SCU_IPC && INTEL_SCU_IPC_UTIL && X86 && GPIO_LANGWELL
	depends on MSIC_GPADC
	select SND_SOC_SN95031
	select SND_SST_PLATFORM
	select SND_INTEL_SST
	default n
	help
          This adds support for ASoC machine driver for Intel(R) MID Medfield platform
          used as alsa device in audio subsystem in Intel(R) MID devices
          Say Y if you have such a device
	  If unsure select "N".

config SND_MFLD_MACHINE_GI
	tristate "SOC Machine Audio driver for Intel Medfield GI board"
	depends on INTEL_SCU_IPC && INTEL_SCU_IPC_UTIL && X86 && GPIO_LANGWELL
	depends on MSIC_GPADC
	select SND_SOC_SN95031
	select SND_SST_PLATFORM
	select SND_INTEL_SST
	default n
	help
          This adds support for ASoC machine driver for Gilligan Island board, based on
	  Intel(R) MID Medfield platform. This will create an alsa sound card.
          Say Y if you have such a device
          If unsure select "N".

config SND_YUKKABEACH_MACHINE
	tristate "SOC Machine Audio driver for Intel Yukkbeach board"
	depends on INTEL_SCU_IPC && INTEL_SCU_IPC_UTIL && X86 && GPIO_LANGWELL
	depends on MSIC_GPADC
	select SND_SOC_SN95031
	select SND_SST_PLATFORM
	select SND_INTEL_SST
	default n
	help
          This adds support for ASoC machine driver for Yukkabeach board, based on
	  Intel(R) MID Medfield platform(and Lexington board). This will create an
	  alsa sound card.
          Say Y if you have such a device
          If unsure select "N".

config SND_CTP_MACHINE
	tristate "SOC Machine Audio driver for Intel Cloverview MID platform"
	depends on INTEL_SCU_IPC_UTIL && X86 && GPIO_LANGWELL
	select SND_SOC_CS42L73
	select SND_SST_PLATFORM
	select SND_INTEL_SST
	select SND_COMPRESS_SST
	select SND_COMPRESS_OFFLOAD
	select SND_SOC_COMMS_SSP
	default n
	help
          This adds support for ASoC machine driver for Intel(R) MID Cloverview platform
	  used as alsa device in audio substem in Intel(R) MID devices
          Say Y if you have such a device
          If unsure select "N".

config SND_INTEL_SST
       tristate

config SND_COMPRESS_SST
	tristate "Compressed framework driver for Intel(R) SST engine"

config SND_SST_PLATFORM
	tristate

config SND_SOC_COMMS_SSP
	tristate "Use ASOC framework to drive AudioComms SSP0 and SSP1"

config SND_MFLD_MONO_SPEAKER_SUPPORT
	tristate "Mono Speaker support for Medfield based devices"
	default N
	help
          This adds support for Mono speaker support on Intel(R) MID Medfield based devices.
          Say Y if you have device with mono speaker. If you say N support for stereo speakers
          will be enabled.
          If unsure select "N".
```
