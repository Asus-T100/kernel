## drivers/base/regmap/Kconfig
```kconfig
# Generic register map support.  There are no user servicable options here,
# this is an API intended to be used by other kernel subsystems.  These
# subsystems should select the appropriate symbols.

config REGMAP
	default y if (REGMAP_I2C || REGMAP_SPI)
	select LZO_COMPRESS
	select LZO_DECOMPRESS
	bool

config REGMAP_I2C
	tristate

config REGMAP_SPI
	tristate

config REGMAP_IRQ
	bool

config REGMAP_ALLOW_WRITE_DEBUGFS
	bool "Regmap write access to usermode"
	default n
	help
	   WARNING: This allows usermode to write to hardware registers. Writing
	   to stuff like PMICs is _never_ advised due to obvious side effects, use
	   at very extreme caution. Is helpful for debugging
```

## drivers/gps/Kconfig
```kconfig
menuconfig GPS
	bool "Gps Adapters"
	default n
	---help---
	  Say Y here to enable selecting GPS adapters.

if GPS

# TI's ST based wl128x GPS
source "drivers/gps/wl128x/Kconfig"

endif # GPS
```

## drivers/gps/intel_mid_gps/Kconfig
```kconfig
#
# Intel MID GPS driver.
#
menu "Intel MID GPS driver"
config INTEL_MID_GPS
	tristate "Intel MID GPS driver"
	depends on X86_INTEL_MID
	help
	  Select this driver to enable kernel interface for GPS devices
	  used in Intel MID platforms.
	  This driver exports GPIO to user space GPS software
	  that use a standard tty to communicate with the GPS device.
endmenu
```

## drivers/hid/ntrig-g4/Kconfig
```kconfig
config HID_NTRIG_G4
	tristate "N-Trig g4 touch screen"
	depends on USB_HID
	help
	  Say Y here if you want to enable support for N-Trig g4
	  touch screen.

	  If unsure, say N.

	  To compile this driver as a module, choose M here.

config NTRIG_SPI_G4
	tristate "NTrig"
	help
	  Say Y here if you want to enable support for N-Trig g4
	  touch screen spi screen.

	  If unsure, say N.

	  To compile this driver as a module, choose M here.
```

## drivers/hsi/Kconfig
```kconfig
#
# HSI driver configuration
#
menuconfig HSI
	bool "HSI support"
	---help---
	  The "High speed synchronous Serial Interface" is
	  synchronous serial interface used mainly to connect
	  application engines and cellular modems.

if HSI

config HSI_NO_MODEM
	bool "HSI no modem support"
	default n
	help
	  modem switch off

source "drivers/hsi/controllers/Kconfig"
source "drivers/hsi/clients/Kconfig"

endif # HSI
```

## drivers/hsi/controllers/Kconfig
```kconfig
#
# HSI controllers configuration
#
comment "HSI controllers"

config HSI_ARASAN
	tristate "intel_mid_hsi HSI hardware driver"
	depends on HSI
	default n
	help
	  If you say Y here, you will enable the intel_mid_hsi HSI hardware
	  driver.

	  If unsure, say N.

if HSI_ARASAN

config HSI_ARASAN_CONFIG
	boolean
	default y

config HSI_WAKEUP_PACKETS_DUMP
	bool "HSI Wakeup packets dump"
	depends on HSI_ARASAN
	default n
	help
		If you say Y here, you will enable the dump of the first packet after
		the HSI controller resume

		If unsure, say N.

endif # HSI_ARASAN
```

## drivers/input/sensors/Kconfig
```kconfig
#
# Sensor driver configuration
#

config SENSORS_KXTJ2
	tristate "KIONIX_ACCEL KXTJ2-1009 g-sensor"
	default n
	depends on I2C
	help
	  If you say yes here you get support for Kionix's
	  digital 3-axis accelerometer KXTJ2-1009.

config SENSORS_AK09911
	tristate "AK09911 compass support"
	default n
	depends on I2C
	help
	  If you say yes here you get support for Asahi Kasei's
	  orientation sensor AK09911.

config SENSORS_CAP1106
	tristate "SMSC CAP1106"
	default n
	depends on I2C
	help
	  Say yes if you want SMSC 1106 cap sensor driver.
	  This is for i2c connected version. If unsure, say N here.
	  To compile this driver as a module, choose m here. The module will
	  be called cap1106.

config INPUT_LID
	tristate "Hall Sensor"
	default n
	depends on INPUT
	help
	  Say Y here if you want to enable the driver of hall sensor.
	  Either a north or south pole of sufficient flux will turn on
	  the output of hall sensor; in the absence of magnetic field,
	  the output is off. You can use this device as a lid switch.
```

## drivers/input/touchscreen/rmi/Kconfig
```kconfig
#
# Touchscreen driver configuration
#

config TOUCHSCREEN_SYNAPTICS_RMI4_I2C
    tristate "Synaptics RMI4 I2C touchscreens"
    depends on I2C
    default n
    help
        Say Y here if you have a Synaptics RMI4 I2C touchscreen connected to
        your system. This enables support for Synaptics RMI4 over I2C based
        touchscreens.
        If unsure, say N.
        To compile this driver as a set of modules, choose M here: the
        modules will be called rmi_core, rmi_app_touchpad, rmi_phys_i2c.

config SYNA_MULTI_TOUCH
	bool "add multi touch support to RMI4 driver"
	default y
	depends on TOUCHSCREEN_SYNAPTICS_RMI4_I2C
	help
	 This option enables multi-touch capabilities in the input device.
	 Driver will report ABS_MT_* event sequence required by kernel
	 multi-touch protocol.

	 If only need single-touch capability, say N.


config SYNA_RMI_DEV
	bool "rmi_dev"
	depends on TOUCHSCREEN_SYNAPTICS_RMI4_I2C
	help
	 Enable mutli-touch capabilities in the input device
```

## drivers/media/radio/wl128x/Kconfig
```kconfig
#
# TI's wl128x FM driver based on TI's ST driver.
#
menu "Texas Instruments WL128x FM driver (ST based)"
config RADIO_WL128X
	tristate "Texas Instruments WL128x FM Radio"
	depends on VIDEO_DEV
	select TI_ST
	help
	This enables the FM driver for TI BT/FM/GPS combo devices
	  This makes use of shared transport line discipline core driver to
	  communicate with the FM core of the combo chip. This is not V4L2 compliant
	  and must be used with TI proprietary MCP stack for FM

endmenu
```

## drivers/media/video/atomisp/Kconfig
```kconfig
config VIDEO_ATOMISP_CSS10
	tristate "Medfield Penwell Image Signal Processor Driver"
	depends on VIDEO_V4L2
	depends on !64BIT
	select VIDEOBUF2_CORE
	select VIDEOBUF2_MEMOPS

	---help---
	  Say Y here if your platform support camera imaging subsystem on
	  the Intel Medfield platform.

	  To compile this driver as a module, choose M here: the
	  module will be called atomisp.
```

## drivers/media/video/atomisp2/Kconfig
```kconfig
config VIDEO_ATOMISP_CSS15
	bool "Intel Atom Image Signal Processor CSS1.5 Driver"
	depends on VIDEO_V4L2
	depends on VIDEO_ATOMISP

	---help---
	  Say Y here if your platform support camera imaging subsystem css1.5
	  on the Intel Atom SoC platform.
config VIDEO_ATOMISP_CSS20
	bool "Intel Atom Image Signal Processor CSS1.5 Driver"
	depends on VIDEO_V4L2
	depends on VIDEO_ATOMISP

	---help---
	  Say Y here if your platform support camera imaging subsystem css2.0
	  on the Intel Atom SoC platform.
config ISP2400
	bool "Intel Atom Image Signal Processor ISP2400 driver"
	depends on VIDEO_V4L2
	depends on VIDEO_ATOMISP

	 ---help---
	  Say Y here if your platform support camera imaging subsystem 2400a0 on
	  the Intel Atom SoC platform.
config ISP2400B0
	bool "Intel Atom Image Signal Processor ISP2400B0 driver"
	depends on VIDEO_V4L2
	depends on VIDEO_ATOMISP

	---help---
	 Say Y here if your platform support camera imaging subsystem 2400b0 on
	 the Intel Atom SoC platform.
```

## drivers/media/video/atomisp3/Kconfig
```kconfig
config VIDEO_ATOMISP_CSS20
	tristate "Intel Atom Image Signal Processor CSS2.0 Driver"
	depends on VIDEO_V4L2
	depends on VIDEO_ATOMISP
	select VIDEOBUF_VMALLOC

	---help---
	  Say Y here if your platform support camera imaging subsystem on
	  the Intel Atom SoC platform.

	  To compile this driver as a module, choose M here: the
	  module will be called atomisp.
config ISP2400
	tristate "Intel Atom Image Signal Processor ISP2400 driver"
	depends on VIDEO_V4L2
	depends on VIDEO_ATOMISP

	 ---help---
	  Say Y here if your platform support camera imaging subsystem 2400b0 on
	  the Intel Atom SoC platform.
config ISP2400B0
	  tristate "Intel Atom Image Signal Processor ISP2400B0 driver"
	  depends on VIDEO_V4L2
	  depends on VIDEO_ATOMISP

	  ---help---
	  Say Y here if your platform support camera imaging subsystem 2400b0 on
	  the Intel Atom SoC platform
```

## drivers/media/video/imx/Kconfig
```kconfig
config VIDEO_IMX
	tristate "sony imx sensor support"
	depends on I2C && VIDEO_V4L2
	---help---
	  This is a Video4Linux2 sensor-level driver for the Sony
	  IMX RAW sensor.

	  It currently depends on internal V4L2 extensions defined in
	  atomisp driver.

choice
	prompt "Select sensor settings"
	depends on VIDEO_IMX

config VIDEO_IMX175
	bool "Sony IMX175 8Mp raw sensor"
	---help---
	  This is sensor driver for Sony IMX175 raw sensor.

	  It currently depends on VIDEO_IMX defined in the above section.
	  And it will be used on MRFLD platform firstly. Enable this if you own imx175
	  sensor and want to use it

endchoice
```

## drivers/misc/bcm-lpm/Kconfig
```kconfig
config BCM_BT_LPM
	tristate "Broadcom Bluetooth Low Power Mode"
	default n
	help
	   Select this module for Broadcom Bluetooth low power management.
```

## drivers/modem_control/Kconfig
```kconfig
#
# Modem Control Driver.
# Perform power on/reset/power off on IMC modems
#

config MDM_CTRL
	bool "Modem control driver"
	default y
	---help---
	  The modem control driver for IMC modems. This driver will perform any
	  power request on IMC modems. It will create /dev/mdm_ctrl char device
	  by default.
	  Verified for XMM6260, XMM7160, XMM6360 and XMM 6263 modems.

config MDM_CTRL_DEV_NAME
	string "Boot driver device name"
	depends on MDM_CTRL
	default "mdm_ctrl"
	---help---
	  Sets the name for the modem control driver device.

	  If unsure, use the default value.

choice
	prompt "IMC reset sequence"
	depends on MDM_CTRL
	default MDM_IMC_6260
	---help---
	  On IMC modems, there are different sequences to boot/reset/power off.
	  The following sequences are specific to IMC XMM7160 and XMM6260 ones
	  but can be used for other modem types.

	  If unsure, use the default value.

config MDM_IMC_6260
	bool "IMC 6260 reset sequence"
	depends on MDM_CTRL
	---help---
	  Uses the XMM6260 sequences in order to boot, reset and power off the
	  modem.
	  Can also be used for XMM6263 modems.

	  If unsure, use the default value.

config MDM_IMC_7160
	bool "IMC 7160 reset sequence"
	depends on MDM_CTRL
	---help---
	  Uses the 7160 sequences in order to boot, reset and power off the
	  modem. Can also be used for XMM6360 modems, based on 7160 hardware.

	  If unsure, use the default value.

endchoice

config MDM_CTRL_CHIPCNTRL_ON
	hex "PMIC register address"
	default 0x06
	depends on MDM_CTRL
	---help---
	  This parameter is the register value that should be modified in
	  in order to get the modem powered up.
	  This parameter depends on the board.

	  If unsure, use the default value.

config MDM_CTRL_CHIPCNTRL_OFF
	hex "PMIC register address"
	default 0x04
	depends on MDM_CTRL
	---help---
	  This parameter is the register value that should be modified in
	  in order to get the modem powered down.
	  This parameter depends on the board.

	  If unsure, use the default value.

config MDM_CTRL_CHIPCNTRL
	hex "PMIC register address"
	default 0x0E0
	depends on MDM_CTRL
	---help---
	  This parameter is the register address that should be modified in
	  in order to get the modem powered up.
	  This parameter depends on the board.

	  If unsure, use the default value.

config MDM_IMC_EARLY_BOOT
	bool "IMC early boot"
	default n
	depends on MDM_CTRL
	---help---
	  Launch boot sequence as early as possible.

	  If unsure, use the default value.
```

## drivers/power/ASUS_BATTERY/TF103CE/Kconfig
```kconfig
#
#  Battery driver configuration
#

menuconfig ASUS_TF103CE_BATTERY
	bool "ASUS TF103C Battery support"
	help
	  Say Y here. This option doesn't affect the kernel.
	  If unsure, say Y.

if ASUS_TF103CE_BATTERY


config ASUS_BATTERY_TF103C_CHARGER_BQ24192
	tristate "TI BQ24192/BQ24191/BQ24190 Charger"
        default y
	select POWER_SUPPLY_CHARGER
	depends on I2C
	help
	  BQ24192 is the charger chip for lithium-ion (Li+) batteries
	  in handheld and portable equipment.

	  Say Y here if you know your platform has this chip for charging
	  support.

config ASUS_BATTERY_TF103CE_CHARGER
	tristate "SMB345 battery charger driver"
   default y
   select POWER_SUPPLY_CHARGER
   depends on I2C
	help
	  Say Y to enable support for the SMB345 switching mode based charger
	  and sysfs. The driver supports controlling charger-enable and
	  current limiting capabilities.

config TF103CE_PMIC_SNB5072C1
	bool "PMIC SNB5072C1"
	depends on TF103CE_BATTERY_SMB345
	help
	  Say Y to enable PMIC SNB5072C1 function

config ASUS_BATTERY_TF103C_UPI_BATTERY
	tristate "UPI ug31xx"
        default y
        depends on I2C
        help
          say Y to enable suspport for the ug31

config SN280X_CHARGER
	bool "charger driver"
	depends on I2C
	help
	  Say Y to enable it

config EC_POWER
	bool "asus ec power information driver"
	depends on EEPROM_PADSTATION
	help
	  Say Y to enable it

config TF103CE_BATTERY_BQ27520
	tristate "BQ27520 battery driver"
	depends on I2C
	help
	  Say Y here to enable support for batteries with BQ27520(I2C) chips.

endif
```

## drivers/power/ASUS_BATTERY/TF303CL/Kconfig
```kconfig
#
#  Copyright (c) 2013, ASUSTek, Inc. All Rights Reserved.
#  Written by tom shen tom_shen@asus.com
#
#  Battery driver configuration
#
#menuconfig ASUS_ENGINEER_MODE
#	bool "ME570KL Battery Engineer Mode"
#	default n
#	help
#	  Say Y here. This option doesn't affect the kernel.
#	  If unsure, say Y.

menuconfig ASUS_TF303CL_BATTERY
	bool "ASUS TF303CL Battery support"
	help
	  Say Y here. This option doesn't affect the kernel.
	  If unsure, say Y.

if ASUS_TF303CL_BATTERY

config ASUS_TF303CL_BATTERY_SMB347
	tristate "SMB347 battery charger driver"
	depends on I2C
	help
	  Say Y to enable support for the SMB347 switching mode based charger
	  and sysfs. The driver supports controlling charger-enable and
	  current limiting capabilities. The driver also lets the
	  SMB347 be operated as a slave device via the power supply
	  framework.

config ASUS_TF303CL_BATTERY_BQ27520
	tristate "ASUS BQ27520 battery driver"
	depends on I2C
	help
	  Say Y here to enable support for batteries with BQ27520(I2C) chips.

config ASUS_TF303CL_BATTERY_BQ27541
	tristate "ASUS BQ27520 battery driver"
	depends on I2C
	help
	  Say Y here to enable support for batteries with BQ27520(I2C) chips.

endif # ASUS_BATTERY
```

## drivers/staging/android/switch/Kconfig
```kconfig
menuconfig ANDROID_SWITCH
	tristate "Android Switch class support"
	help
	  Say Y here to enable Android switch class support. This allows
	  monitoring switches by userspace via sysfs and uevent.

config ANDROID_SWITCH_GPIO
	tristate "Android GPIO Switch support"
	depends on GENERIC_GPIO && ANDROID_SWITCH
	help
	  Say Y here to enable GPIO based switch support.

config ANDROID_SWITCH_MID
	tristate "Jack Switch support"
	depends on ANDROID_SWITCH
	help
	  Say Y here to support switch driver for audio jack detection.

config ANDROID_SWITCH_MID_USER_NOTIFY
	tristate "Userspace notification Switch support"
	help
	  Say Y here to support USER_NOTIFY switch. Needed for devices where
	  userspace requires notification of specific device events reported by drivers to
	  the USER_NOTIFY switch driver.
```
