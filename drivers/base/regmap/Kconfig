## drivers/staging/intel_media/Kconfig
```kconfig
#
# Drm device configuration
#
# This driver provides support for the
# Direct Rendering Infrastructure (DRI) in XFree86 4.1.0 and higher.
#

config DRM_INTEL_MID
	tristate "Intel Moorestown/Medfield (load along with IMG driver)"
	depends on DRM && PCI
	select FB_CFB_COPYAREA
        select FB_CFB_FILLRECT
        select FB_CFB_IMAGEBLIT
        select DRM_KMS_HELPER
        select GENERIC_ALLOCATOR
        select DRM_TTM
	help
	  xxxxxxxxxxxxxxxxxxxxxxxxxx

choice
	prompt "Build IMG kernel service as "
	depends on DRM_INTEL_MID
	default DRM_MID_RELEASE

config DRM_MID_RELEASE
	bool "Release"
	depends on DRM_INTEL_MID
	help
	  Build IMG kernel services as release

config DRM_MID_DEBUG
	bool "Debug"
	depends on DRM_INTEL_MID
	help
	 Build IMG kernel services as debug

endchoice

config DRM_MRST
	tristate "Intel Moorestown"
	depends on DRM_INTEL_MID && PCI
	select FB_CFB_COPYAREA
        select FB_CFB_FILLRECT
        select FB_CFB_IMAGEBLIT
	select DRM_KMS_HELPER
	help
	  Choose this option if you have a Moorestown platform.
          If M is selected the module will be called mid_gfx.

config DRM_MDFLD
	tristate "Intel Medfield"
        depends on DRM_INTEL_MID && PCI
        select FB_CFB_COPYAREA
        select FB_CFB_FILLRECT
        select FB_CFB_IMAGEBLIT
        select DRM_KMS_HELPER
        help
          Choose this option if you have a Medfield platform.
          If M is selected the module will be called mid_gfx.

config DRM_CTP
	tristate "Intel Clover Trail Phone"
        depends on DRM_INTEL_MID && PCI
        select FB_CFB_COPYAREA
        select FB_CFB_FILLRECT
        select FB_CFB_IMAGEBLIT
        select DRM_KMS_HELPER
        help
          Choose this option if you have a Clover Trail Phone
          platform. If M is selected the module will be called
          mid_gfx.

config DRM_CTP_PR1
	tristate "Intel Clover Trail Phone for SGX544MP2(CTP)"
        depends on DRM_CTP
        help
          Choose this option if you have a Clover Trail Phone
          platform. If M is selected the module will be called
          mid_gfx.

config MDFLD_DSI_DSR
	bool "Support DSI Fullscreen Display Self Refreshment "
	depends on (DRM_MDFLD || DRM_CTP) && !MDFLD_DSI_DPU
	default y
	help
	  Choose this option if you have a Type1 MIPI panel.

config MDFLD_DSI_DPU
	bool "Support DSI Display Partial Update"
	depends on DRM_MDFLD || DRM_CTP
	default n
	help
	  xxxxxx

config MDFD_DUAL_MIPI
        bool "SUPPORT_DUAL_MIPI_DISPLAYS"
        depends on DRM_MDFLD || DRM_CTP
        default n
        help
          xxxxxx

config MDFD_HDMI
        bool "SUPPORT_HDMI_DISPLAY"
        depends on DRM_MDFLD || DRM_CTP
        default n
        help
          xxxxxx

config MDFD_HDMI_GREENRIDGE
	  bool "Greenridge HDMI support"
	  depends on MDFD_HDMI
	  help
	    HDMI support for Greenridge.

config MDFD_HDMI_REDRIDGE
	  bool "Red Ridge HDMI support"
	  depends on MDFD_HDMI
	  help
	    HDMI support for Red Ridge.

config MDFD_HDMI_PR2
	  bool "PR2 HDMI support"
	  depends on MDFD_HDMI
	  help
	    HDMI support for PR2.

config CTP_HDMI
	  bool "CTP HDMI support"
	  depends on MDFD_HDMI || DRM_CTP
	  help
	    HDMI support for CTP.

config MDFD_GL3
	bool "Enable GL3 Cache for GUNIT"
	depends on DRM_MDFLD
	default n
	help
	  xxxxxx

config GFX_RTPM
	bool "Enable GFX runtime_pm"
	depends on DRM_MDFLD || DRM_CTP
	default n
	help
	  xxxxxx

config SUPPORT_TOSHIBA_MIPI_DISPLAY
	bool "Support Toshiba TC358762 MIPI Bridge and Toshiba JBT6K84 Panel"
	depends on DRM_MDFLD
	default y
	help
	  xxxxxx

config SUPPORT_TMD_MIPI_600X1024_DISPLAY
       bool "Support Toshiba 600x1024 MIPI interface Panel"
       depends on DRM_MDFLD || DRM_CTP
       default n
       help
         xxxxxx

config SUPPORT_TOSHIBA_MIPI_LVDS_BRIDGE
       bool "Support Toshiba LVDS MIPI Bridge interface Panel"
       depends on DRM_MDFLD || DRM_CTP
       default n
       help
         xxxxxx

config MDFD_VIDEO_DECODE
	bool "Support for Medfield Video Decode"
	depends on DRM_MDFLD || DRM_CTP
	default n
	help
	  xxxxxx

config SUPPORT_MIPI_H8C7_DISPLAY
       bool "Support CMI h8c7 720x1280 MIPI interface Panel"
       depends on DRM_MDFLD || DRM_CTP
       default n
       help
         xxxxxx

config SUPPORT_MIPI_H8C7_CMD_DISPLAY
       bool "Support CMI h8c7 720x1280 MIPI interface Panel"
       depends on DRM_MDFLD || DRM_CTP
       default n
       help
         xxxxxx

config MDFD_VIDEO_ENCODE
	bool "Support for Medfield Video Encode"
	depends on DRM_MDFLD || DRM_CTP
	default n
	help
	  xxxxxx

config SUPPORT_AUO_MIPI_SC1_DISPLAY
	tristate "Support Enzo 540 x 960 MIPI interface Panel in video mode"
	depends on DRM_MDFLD
	default n
	help
	  Choose this option if
	  you have a SC1 video
	  mode MIPI panel, with
	  540 x 960 resolution
	  in portrait mode.

config SUPPORT_AUO_MIPI_SC1_COMMAND_MODE_DISPLAY
	tristate "Support Enzo 540 x 960 MIPI interface Panel in command mode"
	depends on DRM_MDFLD
	default n
	help
	  Choose this option if
	  you have a SC1 command
	  mode MIPI panel, with
	  540 x 960 resolution
	  in portrait mode.

config SUPPORT_GI_MIPI_SONY_DISPLAY
	tristate "Support GI 320 x 480 MIPI interface Panel in video mode"
	depends on DRM_MDFLD
	default n
	help
	  Choose this option if
	  you have a GI video
	  mode MIPI panel, with
	  320 x 480 resolution
	  in portrait mode.

config SUPPORT_GI_MIPI_SONY_COMMAND_MODE_DISPLAY
	tristate "Support GI 320 x 480 MIPI interface Panel in command mode"
	depends on DRM_MDFLD
	default n
	help
	  Choose this option if
	  you have a GI command
	  mode MIPI panel, with
	  320 x 480 resolution
	  in portrait mode.
```

## drivers/staging/intel_sst/Kconfig
```kconfig
config SND_INTEL_SST
	tristate "Intel SST (LPE) Driver"
	depends on X86 && INTEL_SCU_IPC
	default n
	help
	  Say Y here to include support for the Intel(R) MID SST DSP driver
	  On other PC platforms if you are unsure answer 'N'
```

## drivers/staging/matrix/Kconfig
```kconfig
config TOOL_MATRIX
        tristate "Matrix Performance Monitoring tool"
        help
          An interface for performance monitoring tool called Matrx. This tool
	  currently runs on Medfield/Moorestown platforms.
```

## drivers/staging/mrfl/Kconfig
```kconfig
#
# Drm device configuration
#
# This driver provides support for the
# Direct Rendering Infrastructure (DRI) in XFree86 4.1.0 and higher.
#

config DRM_INTEL_HANDSET
	tristate "Intel Merrifield Graphics Driver Support (load along with IMG driver)"
	depends on DRM && PCI
	select FB_CFB_COPYAREA
        select FB_CFB_FILLRECT
        select FB_CFB_IMAGEBLIT
        select DRM_KMS_HELPER
        select DRM_TTM
	help
	  xxxxxxxxxxxxxxxxxxxxxxxxxx

choice
	prompt "Build IMG kernel service as "
	depends on DRM_INTEL_HANDSET
	default DRM_HANDSET_RELEASE

config DRM_HANDSET_RELEASE
	bool "Release"
	depends on DRM_INTEL_HANDSET
	help
	  Build IMG kernel services as release

config DRM_HANDSET_DEBUG
	bool "Debug"
	depends on DRM_INTEL_HANDSET
	help
	  Build IMG kernel services as debug

endchoice

config MRFL_DISPLAY
	tristate "Intel Merrifield Generic Framebuffer Driver"
	depends on PCI && X86_MRFLD && !DRM_MDFLD && FB
	default n
	select FB_CFB_COPYAREA
        select FB_CFB_FILLRECT
        select FB_CFB_IMAGEBLIT
	help
	   Basic support for Generic Framebuffer Driver for Merrifield.

config DRM_MRFLD
        tristate "Intel Merrifield Graphics Driver Support with IMG"
        depends on DRM_INTEL_HANDSET && PCI
        select FB_CFB_COPYAREA
        select FB_CFB_FILLRECT
        select FB_CFB_IMAGEBLIT
        select DRM_KMS_HELPER
        help
          Choose this option if you have a Merrifield platform.
          If M is selected the module will be called mid_gfx.

config PDUMP
        bool "Enable pdump in Merrifield graphics driver"
        depends on DRM_MRFLD
        default n
        help
          Choose this option to enable pdump on Merrifield.

config MID_DSI_DSR
	bool "Support DSI Fullscreen Display Self Refreshment "
	depends on DRM_INTEL_HANDSET && !MID_DSI_DPU
	default y
	help
	  Choose this option if you have a Type1 MIPI panel.

config MID_DSI_DPU
	bool "Support DSI Display Partial Update"
	depends on DRM_INTEL_HANDSET
	default n
	help
	  xxxxxx

config SUPPORT_HDMI
        bool "SUPPORT_HDMI_DISPLAY"
        depends on DRM_MDFLD || DRM_CTP || DRM_MRFLD
        default n
        help
          xxxxxx

config SUPPORT_MIPI_H8C7_VID_DISPLAY
	bool "Support CMI panel on Merrifield"
	depends on DRM_MRFLD
	default n
	help
	  xxxxxx

config SUPPORT_JDI_CMD_DISPLAY
	bool "Support JDI CMD panel on Merrifield"
	depends on DRM_MRFLD
	default n
	help
		support for JDI command panel
		xxxxxx
		xxxxxx
		xxxxxx

config GFX_RTPM
	bool "Enable GFX runtime_pm"
	depends on DRM_INTEL_HANDSET
	default n
	help
          xxxxxx

config SUPPORT_VSP
        bool "SUPPORT_VIDEO_VSP"
        depends on DRM_MRFLD
        default n
        help
          xxxxxx
```

## drivers/staging/mrst/Kconfig
```kconfig
#
# Drm device configuration
#
# This driver provides support for the
# Direct Rendering Infrastructure (DRI) in XFree86 4.1.0 and higher.
#

config DRM_INTEL_MID
	tristate "Intel Moorestown/Medfield (load along with IMG driver)"
	depends on DRM && PCI
	select FB_CFB_COPYAREA
        select FB_CFB_FILLRECT
        select FB_CFB_IMAGEBLIT
        select DRM_KMS_HELPER
        select DRM_TTM
	help
	  xxxxxxxxxxxxxxxxxxxxxxxxxx

choice 
	prompt "Build IMG kernel service as "
	depends on DRM_INTEL_MID
	default DRM_MID_RELEASE

config DRM_MID_RELEASE
	bool "Release"
	depends on DRM_INTEL_MID
	help
	  Build IMG kernel services as release

config DRM_MID_DEBUG
	bool "Debug"
	depends on DRM_INTEL_MID
	help
	 Build IMG kernel services as debug	

endchoice

config DRM_MRST
	tristate "Intel Moorestown"
	depends on DRM_INTEL_MID && PCI
	select FB_CFB_COPYAREA
        select FB_CFB_FILLRECT
        select FB_CFB_IMAGEBLIT
	select DRM_KMS_HELPER
	help
	  Choose this option if you have a Moorestown platform.
          If M is selected the module will be called mid_gfx.

config DRM_MDFLD
	tristate "Intel Medfield"
        depends on DRM_INTEL_MID && PCI
        select FB_CFB_COPYAREA
        select FB_CFB_FILLRECT
        select FB_CFB_IMAGEBLIT
        select DRM_KMS_HELPER
        help
          Choose this option if you have a Medfield platform.
          If M is selected the module will be called mid_gfx.

config DRM_CTP
	tristate "Intel Clover Trail Phone"
        depends on DRM_INTEL_MID && PCI
        select FB_CFB_COPYAREA
        select FB_CFB_FILLRECT
        select FB_CFB_IMAGEBLIT
        select DRM_KMS_HELPER
        help
          Choose this option if you have a Clover Trail Phone
          platform. If M is selected the module will be called
          mid_gfx.

config MDFLD_DSI_DSR
	bool "Support DSI Fullscreen Display Self Refreshment "
	depends on (DRM_MDFLD || DRM_CTP) && !MDFLD_DSI_DPU
	default y
	help
	  Choose this option if you have a Type1 MIPI panel.

config MDFLD_DSI_DPU
	bool "Support DSI Display Partial Update"
	depends on DRM_MDFLD || DRM_CTP
	default n
	help
	  xxxxxx

config MDFD_DUAL_MIPI
        bool "SUPPORT_DUAL_MIPI_DISPLAYS"
        depends on DRM_MDFLD || DRM_CTP
        default n
        help
          xxxxxx

config MDFD_HDMI
        bool "SUPPORT_HDMI_DISPLAY"
        depends on DRM_MDFLD || DRM_CTP
        default n
        help
          xxxxxx

config MDFD_GL3
	bool "Enable GL3 Cache for GUNIT"
	depends on DRM_MDFLD
	default n
	help
	  xxxxxx

config GFX_RTPM
	bool "Enable GFX runtime_pm"
	depends on DRM_MDFLD
	default n
	help
	  xxxxxx

config SUPPORT_TOSHIBA_MIPI_DISPLAY
	bool "Support Toshiba TC358762 MIPI Bridge and Toshiba JBT6K84 Panel"
	depends on DRM_MDFLD
	default y
	help
	  xxxxxx

config SUPPORT_TMD_MIPI_600X1024_DISPLAY
       bool "Support Toshiba 600x1024 MIPI interface Panel"
       depends on DRM_MDFLD || DRM_CTP
       default n
       help
         xxxxxx

config SUPPORT_TOSHIBA_MIPI_LVDS_BRIDGE
       bool "Support Toshiba LVDS MIPI Bridge interface Panel"
       depends on DRM_MDFLD || DRM_CTP
       default n
       help
         xxxxxx

config MDFD_VIDEO_DECODE
	bool "Support for Medfield Video Decode"
	depends on DRM_MDFLD || DRM_CTP
	default n
	help 
	  xxxxxx

config SUPPORT_MIPI_H8C7_DISPLAY
       bool "Support CMI h8c7 720x1280 MIPI interface Panel"
       depends on DRM_MDFLD || DRM_CTP
       default n
       help
         xxxxxx

config MDFD_VIDEO_ENCODE
	bool "Support for Medfield Video Encode"
	depends on DRM_MDFLD || DRM_CTP
	default n
	help
	  xxxxxx
```

## drivers/staging/txei/Kconfig
```kconfig
config INTEL_TXEI
	tristate "Intel VLV IPC Over Trusted Execution Interface (Intel TXEI)"
	depends on X86 && PCI
	help
	  The Intel Trusted Execution Engine (Intel TXEI) provides Manageability,
	  Security and Media services for system containing Intel chipsets.
	  if selected /dev/txei misc device will be created.

	  Supported Chipsets are:
	  Valueview (Baytrail

	  For more information see
	  <http://software.intel.com/en-us/manageability/>

config INTEL_TXEI_DEBUG
	tristate "Intel VLV IPC Over Trusted Execution Interface (Intel TXEI) Debug"
	depends on X86 && PCI && INTEL_TXEI
	help
	  This feature is for testing the Intel Trusted Execution Engint (Intel TXEI).
	  it is to be used only for driver development or hardware testing.

	  It requires the INTEL_TXEI to be enabled.

	  If in doubt, leave off.
```
